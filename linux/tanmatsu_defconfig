## linux/tanmatsu_defconfig
```kconfig
CONFIG_ARCH_RV32I=y
CONFIG_NONPORTABLE=y
# CONFIG_MMU is not set
CONFIG_RISCV_M_MODE=y
CONFIG_PHYS_RAM_BASE_FIXED=y
CONFIG_PHYS_RAM_BASE=0x48000000
CONFIG_ARCH_ESPRESSIF=y
CONFIG_SOC_ESP32P4=y
# CONFIG_SMP is not set
# CONFIG_FPU is not set
# CONFIG_RISCV_ISA_V is not set
# CONFIG_RISCV_ISA_ZAWRS is not set
# CONFIG_RISCV_ISA_ZABHA is not set
# CONFIG_RISCV_ISA_ZACAS is not set
# CONFIG_RISCV_ISA_ZBA is not set
# CONFIG_RISCV_ISA_ZBB is not set
# CONFIG_RISCV_ISA_ZBKB is not set
# CONFIG_RISCV_ISA_ZICBOZ is not set
# CONFIG_RISCV_ISA_VENDOR_EXT is not set
CONFIG_CC_OPTIMIZE_FOR_SIZE=y
CONFIG_EXPERT=y
CONFIG_BASE_SMALL=y
CONFIG_LOCALVERSION="-gaijin-m5"
# CONFIG_LOCALVERSION_AUTO is not set
CONFIG_CMDLINE=""
CONFIG_CMDLINE_FALLBACK=y
CONFIG_ESP32P4_CLIC=y
CONFIG_ESP32P4_SYSTIMER=y
CONFIG_SERIAL_ESP32=y
CONFIG_SERIAL_ESP32P4_USB_JTAG=y
CONFIG_PRINTK_TIME=y
CONFIG_LOG_BUF_SHIFT=16
CONFIG_BLK_DEV_INITRD=y
CONFIG_RD_GZIP=y
CONFIG_BINFMT_FLAT=y
CONFIG_BINFMT_SCRIPT=y
CONFIG_DEVTMPFS=y
CONFIG_DEVTMPFS_MOUNT=y
CONFIG_PROC_FS=y
CONFIG_SYSFS=y
CONFIG_TMPFS=y
CONFIG_BLOCK=y
CONFIG_BLK_DEV_LOOP=y
CONFIG_BLK_DEV_LOOP_MIN_COUNT=4
CONFIG_MMC=y
CONFIG_MMC_BLOCK=y
CONFIG_MMC_TANMATSU_SD=y
CONFIG_PARTITION_ADVANCED=y
CONFIG_MSDOS_PARTITION=y
CONFIG_VFAT_FS=y
CONFIG_FAT_DEFAULT_CODEPAGE=437
CONFIG_FAT_DEFAULT_IOCHARSET="ascii"
CONFIG_NLS_CODEPAGE_437=y
CONFIG_NLS_ASCII=y
CONFIG_SQUASHFS=y
CONFIG_SQUASHFS_ZLIB=y
CONFIG_SQUASHFS_DECOMP_SINGLE=y
CONFIG_SQUASHFS_EMBEDDED=y
CONFIG_SQUASHFS_FRAGMENT_CACHE_SIZE=1
# CONFIG_NET is not set
CONFIG_INPUT=y
CONFIG_INPUT_EVDEV=y
# CONFIG_INPUT_MOUSEDEV is not set
CONFIG_INPUT_KEYBOARD=y
CONFIG_KEYBOARD_TANMATSU_MCU=y
# CONFIG_INPUT_MOUSE is not set
CONFIG_GPIOLIB=y
CONFIG_GPIO_TANMATSU_M2=y
CONFIG_I2C=y
CONFIG_I2C_GPIO=y
# CONFIG_I2C_CHARDEV is not set
CONFIG_VT=y
CONFIG_VT_CONSOLE=y
CONFIG_VT_HW_CONSOLE_BINDING=y
CONFIG_FB=y
CONFIG_FB_DEVICE=y
CONFIG_FB_TANMATSU=y
CONFIG_FRAMEBUFFER_CONSOLE=y
CONFIG_FRAMEBUFFER_CONSOLE_ROTATION=y
# CONFIG_FRAMEBUFFER_CONSOLE_DEFERRED_TAKEOVER is not set
CONFIG_FONT_8x16=y
CONFIG_FONTS=y
CONFIG_FONT_10x18=y
CONFIG_BACKLIGHT_CLASS_DEVICE=y
# CONFIG_DRM is not set
# CONFIG_USB_SUPPORT is not set
# CONFIG_SOUND is not set
# CONFIG_CMA is not set
# CONFIG_MODULES is not set
# CONFIG_STACKPROTECTOR is not set
# CONFIG_GCC_PLUGINS is not set
# CONFIG_KALLSYMS is not set
# CONFIG_FTRACE is not set
# CONFIG_DEBUG_MISC is not set
CONFIG_PANIC_ON_OOPS=y
CONFIG_PANIC_TIMEOUT=0
CONFIG_EXT2_FS=y
CONFIG_MD=y
CONFIG_BLK_DEV_DM=y

CONFIG_POWER_RESET=y
CONFIG_POWER_RESET_TANMATSU=y
```

## main/Kconfig.projbuild
```kconfig
menu "Gaijin diagnostics"

config GAIJIN_USB_EARLYCON
    bool "Enable best-effort early Linux USB logging"
    default n
    help
        Add the USB earlycon argument to the Linux command line. Output is
        dropped when the USB FIFO is full so boot never waits for a reader.
        Keep disabled for release packages; normal kernel logging and the
        USB login shell remain available without this option.

endmenu
```

## sdkconfig.defaults
```kconfig
CONFIG_IDF_TARGET="esp32p4"
CONFIG_BSP_TARGET_TANMATSU=y
CONFIG_IDF_EXPERIMENTAL_FEATURES=y
CONFIG_ESP32P4_SELECTS_REV_LESS_V3=y
CONFIG_ESP32P4_REV_MIN_1=y
CONFIG_ESPTOOLPY_FLASHMODE_QIO=y
CONFIG_ESPTOOLPY_FLASHSIZE_16MB=y
CONFIG_PARTITION_TABLE_CUSTOM=y
CONFIG_PARTITION_TABLE_CUSTOM_FILENAME="partitions.csv"
CONFIG_BOOTLOADER_CUSTOM_RESERVE_RTC=y
CONFIG_BOOTLOADER_CUSTOM_RESERVE_RTC_SIZE=0x100
CONFIG_BOOTLOADER_REGION_PROTECTION_ENABLE=n
CONFIG_SPIRAM=y
CONFIG_SPIRAM_BOOT_INIT=y
CONFIG_SPIRAM_SPEED_200M=y
CONFIG_SPIRAM_USE_MEMMAP=y
CONFIG_SPIRAM_MEMTEST=y
CONFIG_SPIRAM_XIP_FROM_PSRAM=n
CONFIG_SPIRAM_ALLOW_BSS_SEG_EXTERNAL_MEMORY=n
CONFIG_SPIRAM_ALLOW_NOINIT_SEG_EXTERNAL_MEMORY=n
CONFIG_FREERTOS_TASK_CREATE_ALLOW_EXT_MEM=n
CONFIG_BOOTLOADER_WDT_DISABLE_IN_USER_CODE=n
CONFIG_FREERTOS_UNICORE=y
CONFIG_ESP_INT_WDT=n
CONFIG_ESP_TASK_WDT_EN=n
CONFIG_ESP_CONSOLE_USB_SERIAL_JTAG=y
CONFIG_GAIJIN_USB_EARLYCON=n
CONFIG_ESP_MAIN_TASK_STACK_SIZE=8192
CONFIG_ESP_SYSTEM_PANIC_PRINT_REBOOT=y
CONFIG_FATFS_LFN_HEAP=y
CONFIG_FATFS_VOLUME_COUNT=1
CONFIG_PM_ENABLE=n
```

## userspace/Config.in
```kconfig
source "$BR2_EXTERNAL_GAIJIN_PATH/package/gaijin-abi-check/Config.in"
source "$BR2_EXTERNAL_GAIJIN_PATH/package/gaijin-input-test/Config.in"

source "$BR2_EXTERNAL_GAIJIN_PATH/package/gaijin-state/Config.in"
```

## userspace/configs/gaijin_defconfig
```kconfig
BR2_riscv=y
BR2_riscv_custom=y
BR2_RISCV_ISA_RVM=y
BR2_RISCV_ISA_RVA=y
BR2_RISCV_ISA_RVC=y
# BR2_RISCV_ISA_RVF is not set
# BR2_RISCV_ISA_RVD is not set
BR2_RISCV_32=y
# BR2_RISCV_USE_MMU is not set
BR2_RISCV_ABI_ILP32=y
BR2_BINFMT_FLAT=y
BR2_STATIC_LIBS=y
BR2_TOOLCHAIN_BUILDROOT_UCLIBC=y
BR2_PTHREADS_NONE=y
BR2_TARGET_GENERIC_HOSTNAME="gaijin"
BR2_TARGET_GENERIC_ISSUE="Gaijin USB rescue shell"
BR2_INIT_BUSYBOX=y
# BR2_TARGET_GENERIC_GETTY is not set
# BR2_TARGET_GENERIC_REMOUNT_ROOTFS_RW is not set
BR2_ROOTFS_OVERLAY="$(BR2_EXTERNAL_GAIJIN_PATH)/overlay"
BR2_PACKAGE_BUSYBOX_CONFIG_FRAGMENT_FILES="$(BR2_EXTERNAL_GAIJIN_PATH)/busybox.fragment"
BR2_PACKAGE_GAIJIN_ABI_CHECK=y
BR2_PACKAGE_GAIJIN_INPUT_TEST=y
BR2_TARGET_ROOTFS_CPIO=y
BR2_TARGET_ROOTFS_CPIO_GZIP=y
# BR2_TARGET_ROOTFS_TAR is not set
BR2_TARGET_ROOTFS_SQUASHFS=y
BR2_TARGET_ROOTFS_SQUASHFS_BS_32K=y
BR2_TARGET_ROOTFS_SQUASHFS4_GZIP=y
BR2_ROOTFS_POST_BUILD_SCRIPT="$(BR2_EXTERNAL_GAIJIN_PATH)/post-build.sh"

BR2_PACKAGE_GAIJIN_STATE=y

BR2_REPRODUCIBLE=y
```

## userspace/package/gaijin-abi-check/Config.in
```kconfig
config BR2_PACKAGE_GAIJIN_ABI_CHECK
	bool "Gaijin userspace ABI probe"
	help
	  Check integer widths, endianness, libc, software float and vfork/exec.
	  Include a separate native U-mode privilege and signal-return probe.
```

## userspace/package/gaijin-input-test/Config.in
```kconfig
config BR2_PACKAGE_GAIJIN_INPUT_TEST
	bool "Gaijin M2 evdev diagnostic"
	help
	  Inspect keyboard events, repeat and evdev overflow recovery over USB.
```

## userspace/package/gaijin-state/Config.in
```kconfig
config BR2_PACKAGE_GAIJIN_STATE
	bool "Gaijin persistent state and power commands"
	help
	  Validate and map preallocated state-image sectors on read-only FAT.
```
