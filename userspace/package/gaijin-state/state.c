// SPDX-License-Identifier: MIT
#define _GNU_SOURCE
#define _FILE_OFFSET_BITS 64
#include <errno.h>
#include <fcntl.h>
#include <linux/dm-ioctl.h>
#include <linux/fs.h>
#include <linux/loop.h>
#include <limits.h>
#include <stdint.h>
#include <stdio.h>
#include <stdlib.h>
#include <string.h>
#include <sys/ioctl.h>
#include <sys/stat.h>
#include <sys/statfs.h>
#include <sys/statvfs.h>
#include <sys/sysmacros.h>
#include <unistd.h>
#include "gaijin_home.h"
#include "sha256.h"

#define IMAGE "/sd/gaijin/userdata.ext2"
#define NAME "gaijin-state"
#define MAX_RANGES 64
#define TABLE_SIZE 16384
struct extent { uint64_t start, count; };
/* Raw partition reads bypass the stale FAT file page cache on same-boot restarts. */
static unsigned char raw_storage[8192];
static unsigned char table[TABLE_SIZE] __attribute__((aligned(8)));
static uint16_t le16(const unsigned char *p) { return p[0] | (p[1] << 8); }

/* Deliberately narrow on-disk format, generated by tools/create_state.py. */
static int valid_super(const unsigned char *s, uint64_t size)
{
    return gh_format(s,size) && le16(s+58)==1;
}

static struct dm_ioctl *header(void)
{
    struct dm_ioctl *d = (void *)table;
    memset(table, 0, sizeof(table));
    d->version[0] = 4; d->version[1] = 0; d->version[2] = 0;
    d->data_size = sizeof(table); d->data_start = sizeof(*d);
    strcpy(d->name, NAME);
    return d;
}

static int remove_map(int ctl)
{
    header();
    return ioctl(ctl, DM_DEV_REMOVE, table);
}

int main(int argc, char **argv)
{
    int fd = -1, ctl = -1, gate = -1, loop = -1, blocksize, created = 0, rc = 1;
    struct stat file, device;
    struct statfs fs;
    struct statvfs vfs;
    unsigned char super[1024];
    /* bFLT relocation need not retain ELF section alignment. Align at runtime. */
    unsigned char *raw_sector = (void *)(((uintptr_t)raw_storage + 4095) & ~(uintptr_t)4095);
    struct extent ranges[MAX_RANGES];
    unsigned nr = 0, part;
    uint64_t origin = 0, capacity, sectors, logical = 0;
    char path[256], loop_path[64], canonical[PATH_MAX], text[4096];
    size_t used = 0, position;
    struct dm_ioctl *d;
    FILE *start;
    const char *phase = "image path";
    int check_only = argc == 2 && !strcmp(argv[1], "verify-clean");
    int probe = argc == 2 && !strcmp(argv[1], "probe");
    int read_only = argc == 2 && !strcmp(argv[1], "map-ro");
    int reset_token = argc == 2 && !strcmp(argv[1], "reset-token");
    const char *status = "io-error";
    if (argc == 2 && !strcmp(argv[1], "flush")) {
        /* Flush only the live ext2 filesystem, not all block-device aliases.
         * Unlike sync(), syncfs() reports filesystem writeback errors.
         */
        struct statfs fs;
        int flush = open("/persist", O_RDONLY | O_DIRECTORY | O_NOFOLLOW | O_CLOEXEC);
        if (flush < 0) { perror("Gaijin state flush open"); return 1; }
        int err = fstatfs(flush, &fs);
        if (!err && fs.f_type != 0xef53) { errno = EINVAL; err = -1; }
        if (!err) err = syncfs(flush);
        int saved = errno;
        close(flush);
        if (err) { errno = saved; perror("Gaijin state syncfs"); return 1; }
        return 0;
    }
    if (argc == 2 && !strcmp(argv[1], "stop")) {
        ctl = open("/dev/mapper/control", O_RDWR);
        if (ctl < 0 || remove_map(ctl)) { perror("Gaijin state remove"); return 1; }
        close(ctl); return 0;
    }
    if (argc != 1 && !check_only && !probe && !read_only && !reset_token) { fprintf(stderr, "usage: gaijin-state-map [probe|map-ro|reset-token|flush|verify-clean|stop]\n"); return 1; }
    if (!check_only) {
        FILE *boot=fopen("/sys/firmware/devicetree/base/chosen/gaijin,home-status","r");
        if (boot) {
            char value[32]={0};
            int ok=fgets(value,sizeof(value),boot)!=NULL;
            if (fclose(boot)) ok=0;
            if (!ok) goto out;
            if (strcmp(value,"existing") && strcmp(value,"created") && strcmp(value,"recreated")) {
                if (!strcmp(value,"incomplete")) status="incomplete";
                else if (!strcmp(value,"skipped")) status="skipped";
                else if (!strcmp(value,"no-space")) status="no-space";
                else if (!strcmp(value,"reset-refused")) status="reset-refused";
                else if (!strcmp(value,"fat-error")) status="fat-error";
                goto out;
            }
        } else if (errno!=ENOENT) goto out;
    }
    /* A partial loader transaction is never a missing/replaceable image. */
    struct stat artifact;
    const char *artifacts[]={"/sd/gaijin/" GH_TRANSACTION,"/sd/gaijin/" GH_TEMP};
    for (unsigned i=0;i<2;i++) {
        if (!lstat(artifacts[i],&artifact)) { status="incomplete";goto out; }
        if (errno!=ENOENT) goto out;
    }
    /* No path arguments; no symlinks anywhere beneath the read-only FAT mount. */
    if (!realpath(IMAGE, canonical)) {
        if (errno==ENOENT) status="absent";
        else if (errno==ENOTDIR || errno==ELOOP) status="incompatible";
        goto out;
    }
    if (strcmp(canonical,IMAGE)) { status="incompatible";goto out; }
    phase = "read-only FAT image";
    errno = EINVAL;
    fd = open(IMAGE, O_RDONLY | O_NOFOLLOW);
    if (fd < 0 || fstat(fd, &file) || !S_ISREG(file.st_mode) ||
        fstatfs(fd, &fs) || fs.f_type != 0x4d44 || fstatvfs(fd, &vfs) ||
        !(vfs.f_flag & ST_RDONLY) || file.st_size < 16*1024*1024 ||
        file.st_size > 256*1024*1024 || ioctl(fd, FIGETBSZ, &blocksize) ||
        blocksize < 512 || blocksize > 4096 || blocksize % 512 || file.st_size % blocksize) goto out;
    /* st_dev identifies the exact FAT partition, including superfloppy cards. */
    snprintf(path, sizeof(path), "/dev/block/%u:%u", major(file.st_dev), minor(file.st_dev));
    /* devtmpfs need not provide /dev/block links; use the known slot-0 names. */
    for (part = 0; part <= 16; part++) {
        if (part) snprintf(path, sizeof(path), "/dev/mmcblk0p%u", part);
        else strcpy(path, "/dev/mmcblk0");
        if (!stat(path, &device) && S_ISBLK(device.st_mode) && device.st_rdev == file.st_dev) break;
        if (part == 16) goto out;
    }
    phase = "FAT partition capacity";
    gate = open(path, O_RDONLY);
    if (gate < 0 || ioctl(gate, BLKGETSIZE64, &capacity)) goto out;
    close(gate); gate = -1;
    phase = "partition offset";
    if (part) {
        snprintf(text, sizeof(text), "/sys/dev/block/%u:%u/start", major(file.st_dev), minor(file.st_dev));
        start = fopen(text, "r");
        unsigned long long value;
        if (!start) goto out;
        int parsed = fscanf(start, "%llu", &value);
        fclose(start);
        if (parsed != 1) goto out;
        origin = value;
    }
    phase = "allocated image sectors";
    sectors = file.st_size / 512;
    for (uint64_t n = 0; n < (uint64_t)file.st_size / blocksize; n++) {
        int physical = (int)n;
        if (ioctl(fd, FIBMAP, &physical) || physical <= 0) goto out;
        uint64_t sector = (uint64_t)physical * (blocksize / 512);
        uint64_t count = blocksize / 512;
        if (sector + count > capacity/512 || origin + sector + count > UINT32_MAX) goto out;
        if (nr && ranges[nr-1].start + ranges[nr-1].count == sector) ranges[nr-1].count += count;
        else {
            if (nr == MAX_RANGES) goto out;
            ranges[nr++] = (struct extent){sector, count};
        }
    }
    for (unsigned i = 0; i < nr; i++) {
        for (unsigned j = 0; j < i; j++)
            if (ranges[i].start < ranges[j].start+ranges[j].count &&
                ranges[j].start < ranges[i].start+ranges[i].count) goto out;
        int n = snprintf(text+used, sizeof(text)-used, "%llu %llu\n",
            (unsigned long long)(origin+ranges[i].start), (unsigned long long)ranges[i].count);
        if (n < 0 || (size_t)n >= sizeof(text)-used) goto out;
        used += n;
    }
    /* Read ext2's two superblock sectors directly from their allocation. FAT
     * caches the initial clean header even while the live DM device is dirty.
     * Reopening the file alone cannot validate a stop/start or failed mount.
     */
    phase = "fresh ext2 superblock";
    gate = open(path, O_RDONLY | O_DIRECT);
    if (gate < 0) goto out;
    for (unsigned index = 0; index < 2; index++) {
        uint64_t logical_sector = 2 + index;
        unsigned range;
        for (range = 0; range < nr; range++) {
            if (logical_sector < ranges[range].count) break;
            logical_sector -= ranges[range].count;
        }
        if (range == nr || pread(gate, raw_sector, 512,
                (off_t)((ranges[range].start + logical_sector)*512)) != 512) goto out;
        memcpy(super + index*512, raw_sector, 512);
    }
    close(gate); gate = -1;
    errno = EINVAL;
    phase = "ext2 format validation";
    if (!gh_format(super,file.st_size)) { status="incompatible";goto out; }
    if (le16(super+58)==0) status="dirty";
    else if (le16(super+58)==1) status="clean";
    else { status="damaged";goto out; }
    if (reset_token) {
        if (strcmp(status,"dirty")) goto out;
        char cid[35],digest[65];
        FILE *cid_file=fopen("/sys/block/mmcblk0/device/cid","r");
        if (!cid_file) goto out;
        int ok=fgets(cid,sizeof(cid),cid_file)!=NULL;
        if (fclose(cid_file)) ok=0;
        if (!ok || strlen(cid)!=33 || cid[32]!='\n') goto out;
        for (unsigned i=0;i<32;i++) if (!gh_hex(cid[i])) goto out;
        cid[32]=0;
        gh_sha_hex(super,sizeof(super),digest);
        printf(GH_RESET_PREFIX "%s:%08lx:%s\n",cid,(unsigned long)file.st_size,digest);
        rc=0;goto out;
    }
    if (probe) { rc=0;goto out; }
    if (!valid_super(super,file.st_size)) {
        fprintf(stderr,"Gaijin state: ext2 is not clean; recover on a host or explicitly erase home\n");
        phase="ext2 clean flag";goto out;
    }
    if (check_only) { rc=0;goto out; }
    phase = "raw partition loop";
    /* A loop over the raw partition opens it non-exclusively. DM can then
     * claim the loop without conflicting with the read-only FAT holder.
     * No writes pass through the FAT file or change its allocation.
     */
    gate = open("/dev/loop-control", O_RDWR);
    if (gate < 0) goto out;
    int number = ioctl(gate, LOOP_CTL_GET_FREE);
    close(gate); gate = -1;
    if (number < 0) goto out;
    snprintf(loop_path, sizeof(loop_path), "/dev/loop%d", number);
    loop = open(loop_path, O_RDWR);
    gate = open(path, read_only ? O_RDONLY : O_RDWR);
    if (loop < 0 || gate < 0) goto out;
    struct loop_config config = { .fd = gate };
    config.info.lo_flags = LO_FLAGS_AUTOCLEAR | LO_FLAGS_DIRECT_IO | (read_only ? LO_FLAGS_READ_ONLY : 0);
    if (ioctl(loop, LOOP_CONFIGURE, &config)) goto out;
    close(gate); gate = -1;
    phase = "device mapper creation";
    ctl = open("/dev/mapper/control", O_RDWR);
    if (ctl < 0) goto out;
    header();
    if (ioctl(ctl, DM_DEV_CREATE, table)) goto out;
    created = 1;
    d = header(); d->target_count = nr;
    if (read_only) d->flags |= DM_READONLY_FLAG;
    position = d->data_start;
    for (unsigned i = 0; i < nr; i++) {
        struct dm_target_spec *target = (void *)(table+position);
        target->sector_start = logical; target->length = ranges[i].count;
        strcpy(target->target_type, "linear");
        int n = snprintf((char *)(target+1), 128, "%s %llu", loop_path, (unsigned long long)ranges[i].start);
        if (n < 0 || n >= 128) goto out;
        target->next = (sizeof(*target)+n+1+7) & ~7U;
        position += target->next; logical += ranges[i].count;
        if (position+sizeof(*target)+128 > sizeof(table)) goto out;
    }
    phase = "device mapper table";
    if (logical != sectors || ioctl(ctl, DM_TABLE_LOAD, table)) goto out;
    if (!read_only) {
        phase = "frozen SD write ranges";
        gate = open("/sys/class/mmc_host/mmc0/device/write_ranges", O_WRONLY);
        if (gate < 0 || write(gate, text, used) != (ssize_t)used) goto out;
        close(gate); gate = -1;
    }
    phase = "device mapper activation";
    header();
    if (read_only) ((struct dm_ioctl *)table)->flags |= DM_READONLY_FLAG;
    if (ioctl(ctl, DM_DEV_SUSPEND, table)) goto out;
    /* DM ioctl dev uses huge_encode_dev (new_encode_dev on this kernel). */
    d = (void *)table;
    unsigned dev_major = (d->dev & 0xfff00) >> 8;
    unsigned dev_minor = (d->dev & 0xff) | ((d->dev >> 12) & 0xfff00);
    phase = "mapped device node";
    snprintf(path, sizeof(path), "/dev/dm-%u", dev_minor);
    if (mknod(path, S_IFBLK | 0600, makedev(dev_major, dev_minor)) && errno != EEXIST) goto out;
    if (stat(path, &device) || !S_ISBLK(device.st_mode) ||
        device.st_rdev != makedev(dev_major, dev_minor)) goto out;
    puts(path); rc = 0;
out:
    if (probe) { puts(status);rc=0; }
    if (rc) {
        int saved_errno = errno;
        fprintf(stderr, "Gaijin state: %s failed (errno=%d); image preserved\n", phase, saved_errno);
        if (created && remove_map(ctl)) perror("Gaijin state cleanup");
    }
    if (fd >= 0) close(fd);
    if (gate >= 0) close(gate);
    if (ctl >= 0) close(ctl);
    if (loop >= 0) close(loop); /* autoclear when DM releases its final reference */
    return rc;
}
